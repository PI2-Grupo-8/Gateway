## main/Kconfig.projbuild
```kconfig
menu "Access point Configuration"

    config ESP_AP_WIFI_SSID
        string "WiFi SSID"
        default "myssid"
        help
            SSID (network name) for the acces to connect to.

    config ESP_AP_WIFI_PASSWORD
        string "WiFi Password"
        default "mypassword"
        help
            WiFi password (WPA or WPA2) for the acces to use.
    config ESP_AP_WIFI_CHANNEL
        int "WiFi Channel"
        range 1 13
        default 1
        help
            WiFi channel (network channel) for the acces to use.

    config ESP_AP_MAX_STA_CONN
        int "Maximal STA connections"
        default 4
        help
            Max number of the STA connects to AP.
endmenu

menu "Station Configuration"

    config ESP_ST_WIFI_SSID
        string "WiFi SSID"
        default "myssid"
        help
            SSID (network name) for the station to connect to.

    config ESP_ST_WIFI_PASSWORD
        string "WiFi Password"
        default "mypassword"
        help
            WiFi password (WPA or WPA2) for the station to use.

    config ESP_ST_MAXIMUM_RETRY
        int "Maximum retry"
        default 5
        help
            Set the Maximum retry to avoid station reconnecting to the AP unlimited when the AP is really inexistent.
endmenu

menu "Vehicle Configuration"

    config VEHICLE_TOKEN
        string "Token"
        default "JWT eyJhbGciOiJIUzI1NiIsInR5cCI6IkpXVCJ9.eyJlbWFpbCI6ImdhYnJpZWxhYmd1ZWRlc0BnbWFpbC5jb20iLCJuYW1lIjoiZ2FiaSIsIl9pZCI6IjYxNzFkYzdjM2IyY2ZlNGQwYzE3ZTU1NyIsImlhdCI6MTYzNDg1NDkzMX0.Kj3nb4DUcup2efAtb8GRKxuUjemusVtUTUzK8OSHoqw"
        help
            token for vehicle authentication.

    config VEHICLE_API_ROUTE
        string "API Route"
        default "192.168.1.21:3001"
        help
            Route to use Vehicle API.


    config SENSORS_API_ROUTE
        string "sensor API Route"
        default "192.168.1.21:3003"
        help
            Route to use sensor API.

    config VEHICLE_CODE
        string "code"
        default "XLR8" 
        help
            Vehicle code.
endmenu
```
